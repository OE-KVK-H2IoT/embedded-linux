/dts-v1/;
/plugin/;

/ {
	compatible = "brcm,bcm2835";

	fragment@0 {
		target = <&i2c1>;

		__overlay__ {
			#address-cells = <1>;
			#size-cells = <0>;

			mcp9808@18 {
				compatible = "mcp9808";
				reg = <0x18>;
			};
		};
	};
};
