/dts-v1/;
/plugin/;

/ {
	compatible = "brcm,bcm2835";

	fragment@0 {
		target = <&i2c1>;

		__overlay__ {
			#address-cells = <1>;
			#size-cells = <0>;

			ssd1306fb@3c {
				compatible = "ssd1306fb";
				reg = <0x3c>;
				width = <128>;
				height = <64>;
			};
		};
	};
};
